## buildroot/external/package/ardor-pedal/Config.in
```kconfig
config BR2_PACKAGE_ARDOR_PEDAL
	bool "ardor-pedal"
	depends on BR2_INSTALL_LIBSTDCPP
	select BR2_PACKAGE_FFTW
	select BR2_PACKAGE_FFTW_SINGLE
	help
	  Standalone NAM and IR guitar pedal proof-of-concept app.
```
